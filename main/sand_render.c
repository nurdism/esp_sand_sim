#include <stdbool.h>
#include <string.h>

#include "freertos/FreeRTOS.h"
#include "freertos/semphr.h"

#include "esp_attr.h"
#include "esp_check.h"
#include "esp_heap_caps.h"
#include "esp_lcd_panel_io.h"
#include "esp_lcd_panel_ops.h"

#include "sand_menu.h"
#include "sand_render.h"
#include "sand_sim.h"
#include "sand_trace.h"

static const char *TAG = "sand_render";

#if LCD_SWAP_BYTES
/* Same RGB565 value with its two bytes exchanged, for panels that read the
 * high byte off the wire first. The CO5300 does not, so this is normally off. */
#define RGB565(r, g, b) ((uint16_t)(((r) & 0xF8) | (((g) & 0xE0) >> 5) |            \
                                    (((g) & 0x1C) << 11) | (((b) & 0xF8) << 5)))
#else
#define RGB565(r, g, b) ((uint16_t)((((r) & 0xF8) << 8) | (((g) & 0xFC) << 3) | ((b) >> 3)))
#endif

/* One ramp per material, generated by interpolation rather than written out
 * by hand. How far apart the two endpoints sit decides how much texture the
 * material shows: sand wants a wide spread so a heap looks granular, water a
 * narrow one so a body of it reads as a single surface.
 *
 * Black really is off on an AMOLED, so the bowl and its wall vanish and the
 * contents look like a lit disc floating on nothing. */
static const struct { uint8_t r, g, b; } RAMP[MAT_COUNT][2] = {
    [MAT_EMPTY] = { { 0x00, 0x00, 0x00 }, { 0x00, 0x00, 0x00 } },
    [MAT_WALL]  = { { 0x00, 0x00, 0x00 }, { 0x00, 0x00, 0x00 } },
    [MAT_SAND]  = { { 0xC2, 0x80, 0x12 }, { 0xFF, 0xF4, 0xC0 } },
    [MAT_WATER] = { { 0x1E, 0x62, 0xD8 }, { 0x5A, 0xA8, 0xFF } },
    [MAT_ACID]  = { { 0x5E, 0xC8, 0x18 }, { 0xC6, 0xFF, 0x62 } },
    [MAT_STEAM] = { { 0x7A, 0x84, 0x96 }, { 0xD4, 0xDE, 0xEE } },
    /* Acid gas shades by remaining life, so the ramp doubles as its fade. */
    [MAT_ACID_GAS] = { { 0x1C, 0x30, 0x14 }, { 0x9E, 0xE8, 0x46 } },
    [MAT_LAVA]  = { { 0x8E, 0x18, 0x02 }, { 0xFF, 0xC4, 0x38 } },
    /* Fire shades by remaining life too, so a flame is pale at its heart and
     * cools through orange to a dull ember at the edges as it burns out. It
     * runs hotter than lava at the top end - that is what keeps the two apart
     * when they are sitting next to each other. */
    [MAT_FIRE]  = { { 0x8C, 0x10, 0x00 }, { 0xFF, 0xF2, 0xA6 } },
    /* Smoke shades by remaining life like acid gas, so it thins into the
     * black background as it expires. */
    [MAT_SMOKE] = { { 0x10, 0x10, 0x14 }, { 0x74, 0x76, 0x82 } },
    /* Deliberately darker and greyer than wood, which is the other brown in
     * the palette and sits next to it in the ring. */
    [MAT_DIRT]  = { { 0x2E, 0x1E, 0x12 }, { 0x6A, 0x4A, 0x2E } },
    [MAT_WOOD]  = { { 0x54, 0x33, 0x16 }, { 0xA6, 0x74, 0x3E } },
    [MAT_ROCK]  = { { 0x4E, 0x55, 0x60 }, { 0x9C, 0xA6, 0xB4 } },
};

static uint16_t s_palette[CELL_KINDS];

static void build_palettes(void)
{
    for (int m = 0; m < MAT_COUNT; m++) {
        for (int s = 0; s < SHADE_COUNT; s++) {
            const int den = SHADE_COUNT - 1;
            const int r = RAMP[m][0].r + (RAMP[m][1].r - RAMP[m][0].r) * s / den;
            const int g = RAMP[m][0].g + (RAMP[m][1].g - RAMP[m][0].g) * s / den;
            const int b = RAMP[m][0].b + (RAMP[m][1].b - RAMP[m][0].b) * s / den;
            s_palette[CELL_MAKE(m, s)] = RGB565(r, g, b);
        }
    }
}

static esp_lcd_panel_handle_t s_panel;

/* One band buffer. Internal DMA memory so the SPI driver can send it as-is;
 * see BAND_ROWS in sand_config.h for why not PSRAM. Full panel width, so the
 * margin either side of the grid is simply left black from the initial clear
 * and never touched again.
 *
 * Deliberately single-buffered: a transfer is always fully retired before the
 * next draw is issued. Ping-ponging two buffers to overlap painting with DMA
 * meant a transfer was still in flight when the next draw_bitmap ran, and
 * that call then blocks inside esp_lcd on spi_device_get_trans_result with
 * portMAX_DELAY. One transfer that fails to retire parks the frame loop with
 * no way out - which is exactly what kept happening. The overlap was worth
 * maybe a millisecond; the liveness is worth more. */
static uint16_t *s_band;

static SemaphoreHandle_t s_flush_done;
static int s_outstanding;
static bool s_panel_stalled;

static IRAM_ATTR bool on_color_trans_done(esp_lcd_panel_io_handle_t io,
                                          esp_lcd_panel_io_event_data_t *edata,
                                          void *user_ctx)
{
    BaseType_t higher_prio_task_woken = pdFALSE;
    xSemaphoreGiveFromISR(s_flush_done, &higher_prio_task_woken);
    return higher_prio_task_woken == pdTRUE;
}

/* Wait for every issued transfer to finish, so the next draw_bitmap finds
 * nothing queued and its internal portMAX_DELAY drain returns immediately.
 * A stall costs a log line and a skipped frame instead of the whole app. */
static void reap_all(void)
{
    while (s_outstanding > 0) {
        SAND_STAGE("render:reap");
        if (xSemaphoreTake(s_flush_done, pdMS_TO_TICKS(250)) != pdTRUE) {
            ESP_LOGE(TAG, "panel transfer never completed (%d outstanding) - "
                          "skipping further draws", s_outstanding);
            s_outstanding = 0;
            s_panel_stalled = true;
            return;
        }
        s_outstanding--;
    }
}

esp_err_t sand_render_init(esp_lcd_panel_handle_t panel, esp_lcd_panel_io_handle_t io)
{
    s_panel = panel;
    build_palettes();

    s_flush_done = xSemaphoreCreateCounting(4, 0);
    ESP_RETURN_ON_FALSE(s_flush_done, ESP_ERR_NO_MEM, TAG, "no memory for flush semaphore");

    const esp_lcd_panel_io_callbacks_t cbs = {
        .on_color_trans_done = on_color_trans_done,
    };
    ESP_RETURN_ON_ERROR(esp_lcd_panel_io_register_event_callbacks(io, &cbs, NULL), TAG,
                        "cannot hook the panel transfer-done callback");

    s_band = heap_caps_malloc(BAND_BYTES, MALLOC_CAP_DMA | MALLOC_CAP_INTERNAL);
    ESP_RETURN_ON_FALSE(s_band, ESP_ERR_NO_MEM, TAG,
                        "no internal DMA memory for a %u byte band buffer",
                        (unsigned)BAND_BYTES);
    memset(s_band, 0, BAND_BYTES);

    /* Wipe the whole panel once, so the strip outside the grid and anything
     * left in panel RAM from the last boot start out black. */
    for (int y = 0; y < FB_H; y += BAND_PX) {
        const int rows = (y + BAND_PX < FB_H) ? BAND_PX : FB_H - y;
        if (esp_lcd_panel_draw_bitmap(s_panel, 0, y, FB_W, y + rows, s_band) == ESP_OK) {
            s_outstanding++;
        }
        reap_all();
    }

    return ESP_OK;
}

/* Paint grid rows [row_first, row_last) and cell columns [col_first, +cols)
 * into buf as g_cell_px squares, packed at the region's own width. */
static IRAM_ATTR void paint_band(uint16_t *buf, const uint8_t *grid,
                                 int row_first, int row_last, int col_first, int cols)
{
    const int cell = g_cell_px;
    const int pitch = cols * cell;      /* pixels per row in buf */
    const uint16_t *palette = s_palette;

    /* Plain 16-bit stores now that the cell size is a runtime value: it can be
     * odd, so the old pack-two-pixels-per-word trick no longer holds, and an
     * unaligned 32-bit store faults on Xtensa. A cell row is painted once as
     * its top pixel row and the rest copied from it, which turns all but one
     * row in `cell` into a straight memcpy. */
    for (int y = row_first; y < row_last; y++) {
        const uint8_t *cells = grid + y * g_grid_w + col_first;
        uint16_t *px = buf + (y - row_first) * cell * pitch;

        uint16_t *dst = px;
        for (int x = 0; x < cols; x++) {
            const uint16_t colour = palette[cells[x]];
            for (int sx = 0; sx < cell; sx++) {
                *dst++ = colour;
            }
        }
        for (int sy = 1; sy < cell; sy++) {
            memcpy(px + sy * pitch, px, (size_t)pitch * sizeof(uint16_t));
        }
    }
}

const uint16_t *sand_render_palette(void)
{
    return s_palette;
}

void sand_render_palette_set(const uint16_t *palette)
{
    memcpy(s_palette, palette, sizeof(s_palette));
}

void sand_render_palette_reset(void)
{
    build_palettes();
}

void sand_render_palette_override(int material, const uint8_t rgb[][3])
{
    if (material < 0 || material >= MAT_COUNT) {
        return;
    }
    for (int s = 0; s < SHADE_COUNT; s++) {
        s_palette[CELL_MAKE(material, s)] = RGB565(rgb[s][0], rgb[s][1], rgb[s][2]);
    }
}

uint16_t sand_render_material_colour(int material)
{
    if (material < 0 || material >= MAT_COUNT) {
        return 0;
    }
    return s_palette[CELL_MAKE(material, SHADE_COUNT - 1)];
}

void sand_render_material_ramp(int material, uint8_t lo[3], uint8_t hi[3])
{
    if (material < 0 || material >= MAT_COUNT) {
        lo[0] = lo[1] = lo[2] = hi[0] = hi[1] = hi[2] = 0;
        return;
    }
    lo[0] = RAMP[material][0].r;
    lo[1] = RAMP[material][0].g;
    lo[2] = RAMP[material][0].b;
    hi[0] = RAMP[material][1].r;
    hi[1] = RAMP[material][1].g;
    hi[2] = RAMP[material][1].b;
}

void sand_render_frame(const uint8_t *grid)
{
    const int16_t *dirty_lo = sand_dirty_lo();
    const int16_t *dirty_hi = sand_dirty_hi();

    /* The panel has stopped retiring transfers. Keep simulating so the app
     * stays alive and the log keeps flowing, but stop poking the bus. */
    if (s_panel_stalled) {
        sand_clear_dirty();
        return;
    }

    /* An even number of pixel rows per band, so every band starts and ends on
     * an even panel row. With the grid height also even, the short final band
     * comes out even too. */
    int band_rows = BAND_PX / g_cell_px;
    if ((band_rows * g_cell_px) & 1) {
        band_rows--;
    }

    for (int band = 0; band < g_grid_h; band += band_rows) {
        const int band_last = (band + band_rows < g_grid_h) ? band + band_rows : g_grid_h;

        /* Union of the changed spans over the band's rows, and the range of
         * rows actually holding changes - a single falling grain used to
         * repaint and push the full height of its band. Because the bowl is
         * round, bands near the top and bottom are far narrower than the
         * panel even when they are completely churned up. */
        int col_lo = g_grid_w;
        int col_hi = -1;
        int row_lo = band_last;
        int row_hi = band - 1;
        for (int y = band; y < band_last; y++) {
            if (dirty_hi[y] < dirty_lo[y]) {
                continue;
            }
            if (y < row_lo) {
                row_lo = y;
            }
            row_hi = y;
            if (dirty_lo[y] < col_lo) {
                col_lo = dirty_lo[y];
            }
            if (dirty_hi[y] > col_hi) {
                col_hi = dirty_hi[y];
            }
        }
        if (col_hi < col_lo) {
            continue;
        }

        /* Trim to the dirty rows, keeping the pixel window even-aligned the
         * same way the columns are below. Both fixups stay inside the band:
         * it starts and ends on even pixel rows, so an odd top implies room
         * above and an odd height implies room below. */
        if ((g_origin_y + row_lo * g_cell_px) & 1) {
            row_lo--;
        }
        if (((row_hi + 1 - row_lo) * g_cell_px) & 1) {
            row_hi++;
        }
        const int row_last = row_hi + 1;

        /* Widen the span by up to one cell at each end so the pixel window is
         * even-aligned. Painting a cell that was not dirty is free; handing
         * the panel a rectangle it cannot address is not.
         *
         * Both steps are safe at the edges: the origin is even and the grid's
         * pixel width is even, so a span that already reaches an edge is
         * already aligned there. */
        if (((g_origin_x + col_lo * g_cell_px) & 1) && col_lo > 0) {
            col_lo--;
        }
        if ((((col_hi - col_lo + 1) * g_cell_px) & 1) && col_hi + 1 < g_grid_w) {
            col_hi++;
        }

        const int cols = col_hi - col_lo + 1;
        SAND_STAGE_AT("render:paint", band);
        paint_band(s_band, grid, row_lo, row_last, col_lo, cols);
        /* Drawn straight over the finished cells, so the menu never has to be
         * written into the grid and cannot disturb the simulation. */
        menu_overlay(s_band, row_lo, row_last, col_lo, cols);

        const int x_left = g_origin_x + col_lo * g_cell_px;
        const int y_top = g_origin_y + row_lo * g_cell_px;
        SAND_STAGE_AT("render:draw", band);
        const esp_err_t ret = esp_lcd_panel_draw_bitmap(s_panel, x_left, y_top,
                                                        x_left + cols * g_cell_px,
                                                        y_top + (row_last - row_lo) * g_cell_px, s_band);
        if (ret != ESP_OK) {
            ESP_LOGE(TAG, "draw_bitmap band %d (%d,%d %dx%d) failed: %s", band,
                     x_left, y_top, cols * g_cell_px, (row_last - row_lo) * g_cell_px,
                     esp_err_to_name(ret));
        } else {
            s_outstanding++;
        }

        /* Retire it here, before the buffer is repainted and before the next
         * draw_bitmap can block waiting on it. */
        reap_all();
        if (s_panel_stalled) {
            break;
        }
    }

    sand_clear_dirty();
}
